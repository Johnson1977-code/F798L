## CMakeLists.txt
```
cmake_minimum_required(VERSION 3.20.0)

list(APPEND DTS_ROOT ${CMAKE_CURRENT_SOURCE_DIR})

find_package(Zephyr REQUIRED HINTS $ENV{ZEPHYR_BASE})

project(F798L)

target_sources(app PRIVATE src/main.c)

zephyr_library_sources_ifdef(CONFIG_DISPLAY_ST7801N
    drivers/display/panel_st7801n.c)
```

## prj.conf
```kconfig
# BT
CONFIG_BT=y
CONFIG_BT_PERIPHERAL=y
CONFIG_BT_NUS=y
CONFIG_BT_DEVICE_NAME="F798L_ST7801N"
CONFIG_BT_BUF_ACL_RX_SIZE=251
CONFIG_BT_BUF_ACL_TX_SIZE=251

# 新版 NCS/Zephyr NUS 正确符号
CONFIG_BT_ZEPHYR_NUS=y
CONFIG_BT_ZEPHYR_NUS_DEFAULT_INSTANCE=y

# Display
CONFIG_DISPLAY=y
CONFIG_INPUT=y

CONFIG_MSPI=y
CONFIG_MSPI_NRF_SQSPI=y

# LVGL（保守内存）
CONFIG_LVGL=y
CONFIG_LV_COLOR_DEPTH_16=y
CONFIG_LV_Z_MEM_POOL_SIZE=24576
CONFIG_LV_Z_VDB_SIZE=8
CONFIG_LV_Z_FLUSH_THREAD=y
CONFIG_LV_Z_FLUSH_THREAD_STACK_SIZE=2048

# 堆/栈
CONFIG_HEAP_MEM_POOL_SIZE=16384
CONFIG_MAIN_STACK_SIZE=4096
CONFIG_SYSTEM_WORKQUEUE_STACK_SIZE=2048

# 屏驱动开关
CONFIG_DISPLAY_ST7801N=y
```

## src/main.c
```c
#include <zephyr/device.h>
#include <zephyr/drivers/display.h>
#include <zephyr/kernel.h>

static uint8_t framebuf[466 * 2] __aligned(4);

int main(void)
{
    const struct device *disp = DEVICE_DT_GET(DT_CHOSEN(zephyr_display));

    printk("boot\n");

    if (!device_is_ready(disp)) {
        printk("display not ready\n");
        return 0;
    }
    
    display_blanking_off(disp);
    printk("blanking_off done\n");

    for (int i = 0; i < 466; i++) {
        ((uint16_t *)framebuf)[i] = 0xF800;   /* 红 */
    }

    struct display_buffer_descriptor desc = {
        .width = 466, .height = 1, .pitch = 466, .buf_size = 466 * 2,
    };

    int r = display_write(disp, 0, 233, &desc, framebuf);
    printk("write ret=%d\n", r);
    return 0;
}
```
